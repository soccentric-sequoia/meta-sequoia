## conf/layer.conf
```bitbake
BBPATH .= ":${LAYERDIR}"

BBFILES += " \
    ${LAYERDIR}/recipes-*/*/*.bb \
    ${LAYERDIR}/recipes-*/*/*.bbappend \
"

BBFILE_COLLECTIONS += "meta-sequoia"
BBFILE_PATTERN_meta-sequoia = "^${LAYERDIR}/"
BBFILE_PRIORITY_meta-sequoia = "10"

LAYERDEPENDS_meta-sequoia = "core"
LAYERSERIES_COMPAT_meta-sequoia = "scarthgap"
```
